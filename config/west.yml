## config/west.yml
```yaml
manifest:
  remotes:
    - name: zmkfirmware
      url-base: https://github.com/zmkfirmware
    - name: dhruvinsh
      url-base: https://github.com/dhruvinsh
    - name: idefant
      url-base: https://github.com/idefant
    - name: englmaxi
      url-base: https://github.com/englmaxi
    - name: urob
      url-base: https://github.com/urob
  projects:
    - name: zmk
      remote: zmkfirmware
      revision: v0.3.0
      import: app/west.yml
    - name: zmk-tri-state
      remote: dhruvinsh
      revision: ebbc1f0ccdb51669650bb0ac3e34920d09e62400
    - name: zmk-caps-word-ru
      remote: idefant
      revision: main
    - name: zmk-dongle-display
      remote: englmaxi
      revision: v0.3
    - name: zmk-unicode
      remote: urob
      revision: v0.3.0
  self:
    path: config
```
